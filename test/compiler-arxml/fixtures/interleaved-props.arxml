AUTOSAR XML
package /TestPkg
  i signal Speed: i-signal-type=PRIMITIVE, length=8
    network representation props NetProps
  i signal Brake: length=16
