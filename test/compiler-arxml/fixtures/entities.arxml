AUTOSAR XML
package /Test
  i signal Sig1  # Offset > 0 & Offset < 100
