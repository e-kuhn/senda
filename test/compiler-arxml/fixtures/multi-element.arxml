AUTOSAR XML
package /Signals
  i signal BrakePedalPosition: i-signal-type=PRIMITIVE, length=16
  i signal VehicleSpeed: i-signal-type=PRIMITIVE, length=8
package /ECUs
  ecu instance BrakeECU
