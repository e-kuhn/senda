AUTOSAR XML (schema 00052)
package /TestPkg
  unit TestUnit
