AUTOSAR XML
package /Pkg
  i signal Sig1
