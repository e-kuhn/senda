AUTOSAR XML
package /TopLevel/Nested
  system signal NestedSignal
