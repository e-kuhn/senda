AUTOSAR XML (schema 4-3-0)
package /Signals
  i signal TestSignal: length=8
