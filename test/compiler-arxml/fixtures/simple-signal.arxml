AUTOSAR XML
package /Signals
  i signal BrakePedalPosition: i-signal-type=PRIMITIVE, length=16
